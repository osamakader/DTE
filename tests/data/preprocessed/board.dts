// SPDX-License-Identifier: MIT
/dts-v1/;

#include <dt-bindings/test-irq.h>
#include "soc.dtsi"

#define UART_CLOCK 1843200
#define UART_IRQ 33

/ {
	model = "Preprocessed Board";

	chosen {
		stdout-path = &uart0;
	};
};

&uart0 {
	interrupts = <GIC_SPI UART_IRQ IRQ_TYPE_LEVEL_HIGH>;
	clock-frequency = <UART_CLOCK>;
	status = "okay";
};
