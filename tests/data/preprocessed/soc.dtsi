/ {
	#address-cells = <1>;
	#size-cells = <1>;

	soc {
		compatible = "simple-bus";
		#address-cells = <1>;
		#size-cells = <1>;
		ranges;

		uart0: serial@10000000 {
			compatible = "ns16550a";
			reg = <0x10000000 0x1000>;
			status = "disabled";
		};
	};
};
